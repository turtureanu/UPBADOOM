## buildroot-external/Config.in
```kconfig
source "$BR2_EXTERNAL_UPBADOOM_PATH/package/upbadoom/Config.in"
source "$BR2_EXTERNAL_UPBADOOM_PATH/package/fbdoom/Config.in"
source "$BR2_EXTERNAL_UPBADOOM_PATH/package/sedutil-sha512/Config.in"
```

## buildroot-external/configs/x86_64_defconfig
```kconfig
# Target options
## Architecture
BR2_x86_64=y

## Architecture variant
BR2_x86_nocona=y

# Toolchain
## C library
BR2_TOOLCHAIN_BUILDROOT_UCLIBC=y

## Stack protection support (SSP)
BR2_TOOLCHAIN_BUILDROOT_USE_SSP=y

## Compile and install uClibc utilities
BR2_UCLIBC_INSTALL_UTILS=n

## Binutils
BR2_BINUTILS_VERSION_2_39_X=y

## GCC compiler verion
BR2_GCC_VERSION_12_X=y

## Enable C++ support
BR2_TOOLCHAIN_BUILDROOT_CXX=y

# Build options
## Enable compiler cache
BR2_CCACHE=y

# Compiler cache: use relative paths
BR2_CCACHE_USE_BASEDIR=y

## Build packages with link-time optimization
BR2_ENABLE_LTO=y

## Stack Smashing Protection (SSP)
BR2_SSP_STRONG=y

## RELRO Protection
BR2_RELRO_FULL=y

# System configuration
## Run a getty (login prompt) after boot
BR2_TARGET_GENERIC_GETTY=n

## System hostname
BR2_TARGET_GENERIC_HOSTNAME="upbadoom"

## System banner
BR2_TARGET_GENERIC_ISSUE=""

## Password encoding
BR2_TARGET_GENERIC_PASSWD_SHA512=y

## Use symlinks to /usr for /bin, /sbin and /lib
BR2_ROOTFS_MERGED_USR=y

## Enable root login with password
BR2_TARGET_ENABLE_ROOT_LOGIN=n

## Remount root filesystem read-write during boot
BR2_TARGET_GENERIC_REMOUNT_ROOTFS_RW=n

## Root filesystem overlay directories
BR2_ROOTFS_OVERLAY="$(BR2_EXTERNAL_UPBADOOM_PATH)/board/upbadoom/x86_64/rootfs-overlay/"

## Custom scripts to run after creating filesystem images
BR2_ROOTFS_POST_IMAGE_SCRIPT="$(BR2_EXTERNAL_UPBADOOM_PATH)/board/upbadoom/x86_64/post-image.sh"

# Kernel
BR2_LINUX_KERNEL=y

## Kernel version
BR2_LINUX_KERNEL_LATEST_VERSION=y

## Using a custom (def)config file
BR2_LINUX_KERNEL_USE_CUSTOM_CONFIG=y
BR2_LINUX_KERNEL_CUSTOM_CONFIG_FILE="$(BR2_EXTERNAL_UPBADOOM_PATH)/board/upbadoom/x86_64/linux.config"

# Target packages
## FBDOOM (custom)
BR2_PACKAGE_FBDOOM=y

## DOOM WAD
BR2_PACKAGE_DOOM_WAD=y

## UPBADOOM (custom)
BR2_PACKAGE_UPBADOOM=y

## sedutil-sha512 (custom)
BR2_PACKAGE_SEDUTIL_SHA512=y

## kexec
BR2_PACKAGE_KEXEC=y

## kexec zlib support
BR2_PACKAGE_KEXEC_ZLIB=y

## ACPID (enable power button)
BR2_PACKAGE_ACPID=y

# Filesystem
BR2_TARGET_ROOTFS_CPIO=y
BR2_TARGET_ROOTFS_CPIO_FULL=y

## Compression method
BR2_TARGET_ROOTFS_CPIO_GZIP=y

# Bootloaders
## SYSLINUX
BR2_TARGET_SYSLINUX=y
BR2_TARGET_SYSLINUX_EFI=y
```

## buildroot-external/package/fbdoom/Config.in
```kconfig
config BR2_PACKAGE_FBDOOM
	bool "fbdoom"
	help
	  fbdoom is a Linux port of DOOM with framebuffer output support
```

## buildroot-external/package/upbadoom/Config.in
```kconfig
config BR2_PACKAGE_UPBADOOM
    bool "UPBADOOM"
    help
      Uncompicated Pre-Boot Authentication and DOOM

      https://github.com/turtureanu/upbadoom
```
